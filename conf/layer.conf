## conf/layer.conf
```bitbake
BBPATH := "${BBPATH}:${LAYERDIR}"

BBFILES := "${BBFILES} ${LAYERDIR}/recipes-*/*/*.bb \
	${LAYERDIR}/recipes-*/*/*.bbappend"

BBFILE_COLLECTIONS += "alten-playground"
BBFILE_PATTERN_alten-playground := "^${LAYERDIR}/"
BBFILE_PRIORITY_alten-playground = "8"

LICENSE_PATH += "${LAYERDIR}/licenses"

LAYERSERIES_COMPAT_alten-playground = "zeus"
```
